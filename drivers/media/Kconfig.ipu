## drivers/media/Kconfig.ipu
```kconfig
config VIDEO_INTEL_IPU4
	tristate "Intel intel-ipu4 driver"
	depends on ACPI
	select IOMMU_API
	select IOMMU_IOVA
	select X86_DEV_DMA_OPS if X86
	select VIDEOBUF2_DMA_CONTIG
	select PHYS_ADDR_T_64BIT
	select COMMON_CLK
	---help---
	Say Y here!

choice
	prompt "intel-ipu4 hardware type"
	depends on VIDEO_INTEL_IPU4
	default VIDEO_INTEL_IPU4_SOC

config VIDEO_INTEL_IPU4_SOC
	bool "Compile for SOC"

config VIDEO_INTEL_IPU4_FPGA
	bool "Compile for FPGA"

config VIDEO_INTEL_IPU4_ISYS_FPGA
	bool "Compile for ISYS-only FPGA"

config VIDEO_INTEL_IPU4_PSYS_FPGA
	bool "Compile for PSYS-only FPGA"

endchoice

config VIDEO_INTEL_IPU4_DEBUG
	tristate "User space interface for firmware testing"
	depends on VIDEO_INTEL_IPU4
config INTEL_IPU4_BXT_GT_PDATA
	tristate "Enable built in platform data for Broxton-GT"
	---help---
	Pre-ACPI system platform data is compiled inside kernel
config VIDEO_CRLMODULE
	tristate "CRL Module sensor support"
	depends on I2C && VIDEO_V4L2 && VIDEO_V4L2_SUBDEV_API
	depends on MEDIA_CAMERA_SUPPORT
	---help---
	  This is a generic driver for CRL based camera modules.
config VIDEO_DW9714
	tristate "dw9714 voice coil support"
	select REGMAP_I2C
	depends on I2C && VIDEO_V4L2
	---help---
	This is a driver for the DW9714 camera lens voice coil.
```

## ubuntu/ixgbevf-2.14.2/Kconfig
```kconfig
config IXGBEVF_2_14_2
	tristate "ixgbevf version 2.14.2"
	depends on !IXGBEVF && PCI_MSI
	---help---
	ixgbevf Linux* Virtual Function (VF) Driver for Intel® Ethernet
	Network Connection, version 2.14.2.
```

## ubuntu/ixxat/Kconfig
```kconfig
config CAN_HMS_USB
	tristate "HMS USB SocketCAN"
	depends on X86 || X86_64
	depends on USB && CAN_DEV
	---help---
	This driver is from IXXAT and supports SocketCAN over USB.
	(https://www.ixxat.com)
```
